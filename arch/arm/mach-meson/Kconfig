## arch/arm/mach-meson/Kconfig
```kconfig
menu "Meson platform type"
	depends on ARCH_MESON
	  
config MACH_MESON_8726M_REFB04
	select GENERIC_ALLOCATOR
	bool "Support M1 8726(K8) platform(machid=2956)"
	help
	  Include support for the AMLOGIC M1 8726M Emulation Baseboard platform.  
	  
if MACH_MESON_8726M_REFB04

choice
	prompt "hardware board code"
	depends on MACH_MESON_8726M_REFB04
	help
	  Select board type.


	  
config BOARD_G0
	bool "board g0"
	depends on MACH_MESON_8726M_REFB04
	help
	  inand 10 inch	plastic

config BOARD_G1
	bool "board g1"
	depends on MACH_MESON_8726M_REFB04
	help
	  inand 10 inch	plastic cap
	  
config BOARD_H0
	bool "board h0"
	depends on MACH_MESON_8726M_REFB04
	help
	  inand 10 inch meta
config BOARD_H1
	bool "board h1"
	depends on MACH_MESON_8726M_REFB04
	help
	  nand 10 inch  meta cap	  

config BOARD_K0
	bool "board k0"
	depends on MACH_MESON_8726M_REFB04
	help
	  inand 10 inch plastic gps	  
config BOARD_K1
	bool "board k1"
	depends on MACH_MESON_8726M_REFB04
	help
	  inand 10 inch plastic gps cap
endchoice

endif

config BOARD_NAME
	string "board'name"
	default ""
	help
	  board'name

config IMAGE_RECOVERY
    bool "image for recovery"
    default n
	help
	  Select to enable indicate current is recovery image.  	  
	  	  
config MESON_CLOCK_TICK_RATE
    int "Clock Tick Rate"
	default 25000000

config CONFIG_SDCARD_SLEEP
	int "sdcard wait for seconds"
	default "0"

endmenu
```

## drivers/amlogic/i2c/Kconfig
```kconfig
menuconfig AMLOGIC_I2C
        bool "AMLOGIC I2C CONFIG"
if AMLOGIC_I2C
choice	
	prompt "AMLOGIC I2C Hardware Bus support"
        default I2C_SW_AML

config I2C_APOLLO
        bool "APOLLO I2C Controller"
        select I2C
        select I2C_CHARDEV
        help
          If you say yes to this option, support will be included for the I2c
          controller on ARC APOLLO CHIP.

          This driver can also be built as a module.  If so, the module
          will be called i2c-apollo.

config I2C_AML
        bool "Amlogic I2C Driver"
        select I2C
        select I2C_CHARDEV
        select I2C_ALGOBIT
	help
          Yet another Amlogic I2C Driver, normal master

config I2C_SW_AML
        bool "Amlogic software I2C Driver"
        select I2C
        select I2C_CHARDEV
        select I2C_ALGOBIT
	help
          Amlogic software I2C Driver, normal gpio simulate I2C, bit algo
endchoice

config AML_I2C_PM_DISABLE
	tristate "I2c disable power manager"
	depends on I2C_AML
	default n
	help
	  Say Y here if you want to disable the i2c power manager.

	  To compile this driver as a module, choose M here: the
	  module will be called .

config AML_I2C_EXT_PM_DISABLE
	tristate "I2c(ext) disable power manager"
	depends on I2C_AML
	default n
	help
	  Say Y here if you want to disable the ext i2c power manager.

	  To compile this driver as a module, choose M here: the
	  module will be called .

endif
```

## drivers/amlogic/input/adc_keypad/Kconfig
```kconfig
#
# Input core configuration
#



config ADC_KEYPADS_AM
	tristate "Amlogic ADC keypad support"
	depends on SARADC_AM
	default n
	help
	  Say Y here if you want to use the amlogic ADC keypad.

	  To compile this driver as a module, choose M here: the
	  module will be called .

config ADC_KEYPADS_GPIO_SUPPORT
	tristate "Amlogic ADC keypad support gpio key"
	depends on ADC_KEYPADS_AM
	default n
	help
	  Say Y here if you want to use the amlogic ADC keypad GPIO.

	  To compile this driver as a module, choose M here: the
	  module will be called .

config ADC_KEYPADS_FN_SUPPORT
	tristate "Amlogic ADC keypad support Fn key"
	depends on ADC_KEYPADS_AM
	default n
	help
	  Say Y here if you want to use the amlogic ADC keypad Fn.

	  To compile this driver as a module, choose M here: the
	  module will be called .

config ADC_KEYPADS_SCAN_TICKS
    int "Amlogic ADC keypad scan rate(in ticks)"
	depends on ADC_KEYPADS_AM
	default 10
	help
	  Say Y here if you want to use the amlogic ADC keypad Fn.

	  To compile this driver as a module, choose M here: the
	  module will be called .	  
	  
```

## drivers/amlogic/input/touch_screen/Kconfig
```kconfig
#
# Input core configuration
#

config SINTEK_CAPACITIVE_TOUCHSCREEN
	tristate "Sintek capacitive touch panel"
	default n
	help
	  Say Y here if you want to use the Sintek capacitive panel.

	  To compile this driver as a module, choose M here: the
	  module will be called .

config ITK_CAPACITIVE_TOUCHSCREEN
	tristate "ITK capacitive touch panel"
	default n
	help
	  Say Y here if you want to use the ITK capacitive panel.

	  To compile this driver as a module, choose M here: the
	  module will be called .

config EETI_CAPACITIVE_TOUCHSCREEN
	tristate "EETI capacitive touch panel"
	default n
	help
	  Say Y here if you want to use the EETI capacitive panel.

	  To compile this driver as a module, choose M here: the
	  module will be called .

config SIS92XX_CAPACITIVE_TOUCHSCREEN
	tristate "sis92xx capacitive touch panel"
	depends on I2C
	default n
	help
	  Say Y here if you want to use the sis92xx capacitive panel.

	  To compile this driver as a module, choose M here: the
	  module will be called .

config HX8520_CAPACITIVE_TOUCHSCREEN
	tristate "HX8520 capacitive touch panel"
	depends on I2C
	default n
	help
	  Say Y here if you want to use the HX8520 capacitive panel.

	  To compile this driver as a module, choose M here: the
	  module will be called .
	  
config RAYDIUM_CAPACITIVE_TOUCHSCREEN
	tristate "Raydium capacitive touch panel"
	depends on I2C
	default n
	help
	  Say Y here if you want to use the Raydium capacitive panel.

	  To compile this driver as a module, choose M here: the
	  module will be called .
	  
config GOODIX_CAPACITIVE_TOUCHSCREEN
	tristate "Goodix capacitive touch panel"
	depends on I2C
	default n
	help
	  Say Y here if you want to use the Goodix capacitive panel.

	  To compile this driver as a module, choose M here: the
	  module will be called .
config UOR7X5X_RESISTIVE_TOUCHSCREEN
	tristate "UOR7X5X resistive touch panel"
	default n
	help
	  Say Y here if you want to use the UOR7X5X resistive panel.

	  To compile this driver as a module, choose M here: the
	  module will be called .  
config UOR6X5X_RESISTIVE_TOUCHSCREEN
	tristate "UOR6X5X resistive touch panel"
	default n
	help
	  Say Y here if you want to use the UOR6X5X resistive panel.

config UOR6153_RESISTIVE_TOUCHSCREEN
	tristate "UOR6153 resistive touch panel"
	default n
	help
	  Say Y here if you want to use the UOR6153 resistive panel.
	  
config PIXCIR_CAPACITIVE_TOUCHSCREEN
	tristate "pixcir capacitive touch panel"
	depends on I2C
	default n
	help
	  Say Y here if you want to use the pixcir capacitive panel.

	  To compile this driver as a module, choose M here: the
	  module will be called .

config PIXCIR_C44_CAPACITIVE_TOUCHSCREEN
	tristate "pixcir c44 capacitive touch panel"
	depends on I2C
	default n
	help
	  Say Y here if you want to use the pixcir capacitive panel.

	  To compile this driver as a module, choose M here: the
	  module will be called .

config PIXCIR_SKIP_CALIBRATION
	tristate "pixcir capacitive skip auto calibration"
	depends on (PIXCIR_CAPACITIVE_TOUCHSCREEN || PIXCIR_C44_CAPACITIVE_TOUCHSCREEN)
	default n
	help
	  Say Y here if you want to use the pixcir capacitive panel auto calibration.

	  To compile this driver as a module, choose M here: the
	  module will be called .

config PIXCIR_RESOLUTION_STD_1024_600_STD0
	tristate "pixcir capacitive touch panel resolution 1024 600 std0"
	depends on (PIXCIR_CAPACITIVE_TOUCHSCREEN || PIXCIR_C44_CAPACITIVE_TOUCHSCREEN)
	default n
	help
	  Say Y here if you want to use the pixcir capacitive 1024 600 std1.

	  To compile this driver as a module, choose M here: the
	  module will be called .
	  
config PIXCIR_RESOLUTION_STD_1024_600_STD1
	tristate "pixcir capacitive touch panel resolution 1024 600 std1"
	depends on (PIXCIR_CAPACITIVE_TOUCHSCREEN || PIXCIR_C44_CAPACITIVE_TOUCHSCREEN)
	default n
	help
	  Say Y here if you want to use the pixcir capacitive 1024 600 std1.

	  To compile this driver as a module, choose M here: the
	  module will be called .

config PIXCIR_RESOLUTION_STD_1024_600_NTD0
	tristate "pixcir capacitive touch panel resolution 1~1023 1~600 ntd0"
	depends on (PIXCIR_CAPACITIVE_TOUCHSCREEN || PIXCIR_C44_CAPACITIVE_TOUCHSCREEN)
	default n
	help
	  Say Y here if you want to use the pixcir capacitive 1024 600 std1.

	  To compile this driver as a module, choose M here: the
	  module will be called .
	  
config TOUCHSCREEN_NAS_MUTIL
	tristate "nas mutil touch panel"
	default n
	help
	  Say Y here if you want to use the nas mutil panel.

config FT5301_TOUCHSCREEN
	tristate "FT5301 capacitive touch panel"
	default n
	help
	  Say Y here if you want to use the ft5301 panel.

config NOVATEK_TOUCHSCREEN
	tristate "Novatek capacitive touch panel"
	default n
	help
	  Say Y here if you want to use the ft5301 panel.

config ILITEK_CAPACITIVE_TOUCHSCREEN
	tristate "ilitek mutil touch panel"
	default n
	help
	  Say Y here if you want to use the ilitek mutil panel.	  

config TOUCHSCREEN_INDEPENDENT_I2C
	tristate "touchscreen at indepent i2c bus"
	default n
	help
	  Say Y here if you want to use the touchscreen at independent i2c bus.

config TOUCHSCREEN_TS_KEY
	tristate "touchscreen has keyboard support"
	default n
	help
	  Say Y here if you want to use the touchscreen keyboard.

config TOUCHSCREEN_ENABLE_PIN_LEVEL
	int "touchscreen enable pin level"
	range 0 1
	default 1
	---help---
	  set the value of enable pin

config TOUCHSCREEN_INIT_ENABLED
	int "touchscreen init at enable status"
	range 0 1
	default 1
	help
	  Say Y here if you want to enable touch at boot step
	  
```

## drivers/amlogic/power/Kconfig
```kconfig
menu "Amlogic Power Management Support"

config AMLOGIC_PM
	bool "Amlogic Power support"
	select POWER_SUPPLY
	default n
	help
	  Say Y here if you want to use the amlogic power management.

if AMLOGIC_PM

choice
	prompt "battery source select"
	depends on AMLOGIC_PM
	help
	  Select board type.

config BATT_7V4_330_150
	bool "7.4V divide resistor 330k ohm/150k ohm"
	depends on AMLOGIC_PM
	help
	  7.4V 330ohm/150ohm battery check

config BATT_7V4_330_150_V2
	bool "7.4V divide resistor 330k ohm/150k ohm version 2"
	depends on AMLOGIC_PM
	help
	  7.4V 330ohm/150ohm battery check version 2
	  
config BATT_3V7_110_110
	bool "3.7V divide resistor 110k ohm/110k ohm"
	depends on AMLOGIC_PM
	help
	  7.4V 110ohm/110ohm battery check

config BATT_3V7_110_110_V2
	bool "3.7V divide resistor 110k ohm/110k ohm version 2"
	depends on AMLOGIC_PM
	help
	  7.4V 110ohm/110ohm battery check version 2

endchoice

endif

config AMLOGIC_PM_COMPENSATION
	bool "Amlogic Power compensate when 3.3v"
	default n
	help
	  Say Y here if you want to use the 3.3v compensation.

config AMLOGIC_PM_ADC_STAGNATE_SECOND
	depends on AMLOGIC_PM_COMPENSATION
	int "Default Adc Stagnate Second"
	range 1 4096
	default 30
	---help---
	  The stagnate adc second, which adc steady mean power less

config AMLOGIC_PM_ADC_STAGNATE_SECOND_STEADY
	depends on AMLOGIC_PM_COMPENSATION
	int "Default Adc Stagnate Second Steady"
	range 1 3600
	default 300
	---help---
	  After adc stagnate,continue discharge second

config SMBA10XX_BATTERY
	boolean "SMBA10XX battery driver support"
	depends on I2C_AML
	default n
	help
	  Say Y if you want to add battery driver supoort for SMBA10XX
	  
config BQ27x00_BATTERY
	bool "BQ27x00 Battery support"
	select POWER_SUPPLY
	depends on I2C_AML	
	default n
	help
	  Say Y here if you want to add battery driver supoort for bq27x00.
	  
endmenu
```

## drivers/amlogic/zt/Kconfig
```kconfig
#
# Canvas management driver configuration
#

menu "zt interface"

config ZT_INTERFACE
    bool "zt android interface"
    default y
	help
	  Select to enable Canvas management driver.

config ZT_ENCRYPT
	default n
	bool "zt encrypt"
	---help---
	  zt encrypt

config UART_GPS
        bool "USE UART GPS"     
        depends on ZT_INTERFACE
        default n
        help
           hardware uart gps control
config GPS_POWER_CONTROL
        bool "USE GPS POWER CONTROL"     
        depends on UART_GPS
        default n
        help
           gps power control  
config GPS_SWITCH_CONTROL
        bool "USE GPS SWITCH CONTROL"     
        depends on UART_GPS
        default n
        help
           gps switch control  

endmenu
```

## drivers/i2c/chips/Kconfig
```kconfig
#
# Miscellaneous I2C chip drivers configuration
#
# *** DEPRECATED! Do not add new entries! See Makefile ***
#

menu "Miscellaneous I2C Chip support"

config ECOMPASS
	tristate "MEMSIC eCompass Driver Support"
	depends on I2C
	help
	  If you say yes here you get support for the MEMSIC eCompass

config SENSORS_AAC
	tristate "Accelerometer Sensor Driver Support"
	depends on ECOMPASS
	help
	  If you say yes here you get support for the accelerometer sensor

config SENSORS_ECOMPASS
	tristate "eCompass Sensor Driver Support"
	depends on ECOMPASS
	help
	  If you say yes here you get support for the accelerometer sensor

endmenu
```

## sound/soc/aml/Kconfig
```kconfig
config SND_AML_SOC
	tristate "soc audio for AMLogic Ssystem-on-system"
	depends on ARCH_MESON || ARCH_A1H || ARM
	help
	  Say Y or M if you want to add support for codecs attached to
	  the AMLogic I2S interface. You will also need
	  to select the audio interfaces to support below.
	  
config SND_AML_M1
	tristate "M1 evaluation board with internel audio dac"
	depends on SND_AML_SOC


config SND_AML_M1_MID_WM8900
	tristate "AML6236 MID board with WM8900"
	depends on SND_AML_SOC
        select SND_SOC_WM8900 if SND_AML_M1_MID_WM8900

config SND_AML_M1_ARMDEV_WM8900
	tristate "AML8726M ARM Dev board with WM8900"
	depends on SND_AML_SOC
		select SND_SOC_WM8900 if SND_AML_M1_ARMDEV_WM8900
	
config SND_AML_M1_MID_RT5621
	tristate "AML8726M MID board with RT5621"
	depends on SND_AML_SOC
		select SND_SOC_RT5621 if SND_AML_M1_MID_RT5621

config SND_AML_M1_MID_WM8988
	tristate "AML8726 MID board with WM8988"
	depends on SND_AML_SOC
        select SND_SOC_WM8988 if SND_AML_M1_MID_WM8988

config SND_AML_M1_MID_ES8388
	tristate "AML8726 MID board with ES8388"
	depends on SND_AML_SOC
        select SND_SOC_ES8388 if SND_AML_M1_MID_ES8388
```
